## configs/coreboot/emulation_qemu_q35.defconfig
```kconfig
CONFIG_VENDOR_EMULATION=y
CONFIG_BOARD_EMULATION_QEMU_X86_Q35=y
CONFIG_CBFS_SIZE=0x400000
CONFIG_CONSOLE_SERIAL=y
CONFIG_PAYLOAD_SEABIOS=y
CONFIG_SEABIOS_STABLE=y
```

## configs/coreboot/lenovo_thinkpad_13_gen2_bringup.defconfig
```kconfig
CONFIG_USE_BLOBS=y
CONFIG_VENDOR_LENOVO=y
CONFIG_BOARD_LENOVO_THINKPAD_13_GEN2=y
CONFIG_FMDFILE="src/mainboard/lenovo/thinkpad_13_gen2/board.fmd"
CONFIG_MAINBOARD_USE_LIBGFXINIT=y
CONFIG_LINEAR_FRAMEBUFFER=y
CONFIG_INTEL_GMA_ADD_VBT=y
CONFIG_INTEL_GMA_VBT_FILE="src/mainboard/lenovo/thinkpad_13_gen2/data.vbt"
CONFIG_CPU_MICROCODE_CBFS_DEFAULT_BINS=y
CONFIG_CONSOLE_CBMEM=y
CONFIG_CONSOLE_SPI_FLASH=y
CONFIG_PAYLOAD_SEABIOS=y
CONFIG_SEABIOS_STABLE=y
```

## configs/coreboot/lenovo_thinkpad_13_gen2_uefi.defconfig
```kconfig
CONFIG_USE_BLOBS=y
CONFIG_VENDOR_LENOVO=y
CONFIG_BOARD_LENOVO_THINKPAD_13_GEN2=y
CONFIG_MAINBOARD_USE_LIBGFXINIT=y
CONFIG_LINEAR_FRAMEBUFFER=y
CONFIG_INTEL_GMA_ADD_VBT=y
CONFIG_INTEL_GMA_VBT_FILE="src/mainboard/lenovo/thinkpad_13_gen2/data.vbt"
CONFIG_CPU_MICROCODE_CBFS_DEFAULT_BINS=y
CONFIG_SMMSTORE=y
CONFIG_DRIVERS_OPTION_CFR_ENABLED=y
CONFIG_PAYLOAD_EDK2=y
CONFIG_EDK2_FULL_SCREEN_SETUP=y
CONFIG_EDK2_BOOT_MANAGER_ESCAPE=y
```

## configs/coreboot/lenovo_x230.defconfig
```kconfig
CONFIG_VENDOR_LENOVO=y
CONFIG_BOARD_LENOVO_X230=y
CONFIG_USE_NATIVE_RAMINIT=y
CONFIG_MAINBOARD_USE_LIBGFXINIT=y
CONFIG_LINEAR_FRAMEBUFFER=y
CONFIG_PAYLOAD_SEABIOS=y
CONFIG_SEABIOS_STABLE=y
```

## ports/lenovo_thinkpad_13_gen2/Kconfig
```kconfig
# SPDX-License-Identifier: GPL-2.0-only

if BOARD_LENOVO_THINKPAD_13_GEN2

config BOARD_SPECIFIC_OPTIONS
	def_bool y
	select AZALIA_USE_LEGACY_VERB_TABLE
	select BOARD_ROMSIZE_KB_16384
	select DRIVERS_OPTION_CFR_ENABLED if PAYLOAD_EDK2 && SMMSTORE
	select HAVE_ACPI_RESUME
	select HAVE_ACPI_TABLES
	select INTEL_GMA_HAVE_VBT
	select MAINBOARD_HAS_LIBGFXINIT
	select MAINBOARD_HAS_TPM2
	select MAINBOARD_USES_IFD_GBE_REGION
	select MEMORY_MAPPED_TPM
	select SOC_INTEL_COMMON_BLOCK_HDA_VERB
	select SOC_INTEL_KABYLAKE
	select SPD_READ_BY_WORD
	select SYSTEM_TYPE_LAPTOP

config MAINBOARD_DIR
	default "lenovo/thinkpad_13_gen2"

config MAINBOARD_PART_NUMBER
	default "ThinkPad 13 2nd Gen"

config FMDFILE
	default "src/mainboard/$(CONFIG_MAINBOARD_DIR)/board.fmd"

config DIMM_MAX
	default 2

config DIMM_SPD_SIZE
	default 512

config CONSOLE_SERIAL
	default n

config CONSOLE_CBMEM
	default y

config CONSOLE_SPI_FLASH
	default y

config NO_POST
	default n

config EDK2_BOOT_MANAGER_ESCAPE
	default y

config EDK2_FOLLOW_BGRT_SPEC
	default y

config EDK2_FULL_SCREEN_SETUP
	default y

config PS2K_EISAID
	default "MSFT0001"

config PS2M_EISAID
	default "LEN2032"

endif
```

## ports/lenovo_thinkpad_13_gen2/Kconfig.name
```kconfig
# SPDX-License-Identifier: GPL-2.0-only

config BOARD_LENOVO_THINKPAD_13_GEN2
	bool "ThinkPad 13 2nd Gen (20J1/20J2)"
```
